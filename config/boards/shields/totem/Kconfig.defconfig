## config/boards/shields/totem/Kconfig.defconfig
```kconfig
# Copyright (c) 2022 The ZMK Contributors
# SPDX-License-Identifier: MIT

config SHIELD_TOTEM_LEFT
    def_bool $(shields_list_contains,totem_left)

if SHIELD_TOTEM_LEFT

config ZMK_KEYBOARD_NAME
    default "Totem Left"
    
config ZMK_SPLIT_ROLE_CENTRAL
    default y

endif

config SHIELD_TOTEM_RIGHT
    def_bool $(shields_list_contains,totem_right)

if SHIELD_TOTEM_RIGHT

config ZMK_KEYBOARD_NAME
    default "Totem Right"

endif

if SHIELD_TOTEM_LEFT || SHIELD_TOTEM_RIGHT

config ZMK_SPLIT
    default y

endif

# Enable dynamic macros
config ZMK_DYNAMIC_MACROS
    default y
```
